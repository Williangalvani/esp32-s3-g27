## sdkconfig.defaults
```kconfig
CONFIG_TINYUSB_ENABLED=y
CONFIG_TINYUSB_HID_ENABLED=y
CONFIG_TINYUSB_CDC_ENABLED=n
CONFIG_TINYUSB_MSC_ENABLED=n
CONFIG_TINYUSB_MIDI_ENABLED=n
CONFIG_TINYUSB_CUSTOM_CLASS_ENABLED=n
CONFIG_TINYUSB_HID_COUNT=1
```
